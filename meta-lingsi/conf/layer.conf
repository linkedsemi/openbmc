## meta-lingsi/meta-raptor/conf/machine/raptor.conf
```bitbake
# require conf/machine/include/riscv/tune-riscv.inc
require riscv-common.inc
require conf/machine/include/obmc-bsp-common.inc

#============================================
# Preferred Providers
PREFERRED_VERSION_opensbi = "1.4"
PREFERRED_PROVIDER_virtual/kernel = "linux-lingsi"
# PREFERRED_VERSION_linux-thead = "5.10.y"
PREFERRED_PROVIDER_virtual/bootloader = "u-boot-lingsi"
EXTRA_IMAGEDEPENDS += " virtual/bootloader"
# PREFERRED_VERSION_u-boot = "1:2020.10"
#============================================

#============================================
# SBI Configuration
#- This sets u-boot as the default OpenSBI payload
#-- Nezha board uses TOC1 images loaded by SPL and containing U-Boot, DTB, and
#-- OpenSBI so 'RISCV_SBI_PAYLOAD' isn't used.
#-- 'RISCV_SBI_FDT' isn't used because the DTB is loaded from RAM at
#-- ${fdtcontroladdr}
unset RISCV_SBI_PAYLOAD
# RISCV_SBI_FDT = "lsbmc_evk.dtb"
#============================================

#============================================
# Uboot Configuration
# UBOOT_MACHINE = "starfive_jh7100_visionfive_smode_defconfig"
UBOOT_MACHINE = "lsbmc_evk_defconfig"
UBOOT_DTB = "1"
UBOOT_DTB_BINARY = "lsbmc_evk.dtb"
UBOOT_ELF = "u-boot"
UBOOT_SIGN_ENABLE = "1"
UBOOT_ENTRYPOINT = "0x40200000"
# UBOOT_DTB_LOADADDRESS = "0x42200000"
#============================================

#============================================
# Kernel Configuration
#-- 'KERNEL_DEVICETREE' isn't used because the DTB is loaded from RAM
#-- at address ${fdtcontroladdr}
KERNEL_DEVICETREE ?= "lingsi/lsbmc_fpga.dtb"
# KBUILD_DEFCONFIG = "raptor_fpga_defconfig"
#============================================

#============================================
# Image Configuration
## Do not update fstab file when using wic images
IMAGE_BOOT_FILES:append = " ${RISCV_SBI_FDT}"
IMAGE_BOOT_FILES:append = " u-boot.bin"
# WIC_CREATE_EXTRA_ARGS ?= "--no-fstab-update"
WIC_CREATE_EXTRA_ARGS = ""
WKS_FILE_DEPENDS = ""
# WKS_FILE ?= ""
# KERNEL_IMAGETYPES = " Image"
IMAGE_FSTYPES = "cpio.gz cpio.gz.u-boot ext4"
#============================================

#============================================
# Machine Features
# MACHINE_EXTRA_RRECOMMENDS += "kernel-modules"
# root auto login
EXTRA_IMAGE_FEATURES:remove = "debug-tweaks"
IMAGE_FEATURES:remove = "debug-tweaks"
IMAGE_FEATURES:append = " empty-root-password serial-autologin-root"
#============================================
```

## meta-linkedsemi/conf/layer.conf
```bitbake
BBPATH .= ":${LAYERDIR}"
BBFILES += "${LAYERDIR}/recipes-*/*/*.bb \
            ${LAYERDIR}/recipes-*/*/*.bbappend"

BBFILE_COLLECTIONS += "linkedsemi-sdk-layer"
BBFILE_PATTERN_linkedsemi-sdk-layer := "^${LAYERDIR}/"
BBFILE_PRIORITY_linkedsemi-sdk-layer = "10"

LAYERVERSION_linkedsemi-sdk-layer = "1"
LAYERDEPENDS_linkedsemi-sdk-layer = "core"
LAYERSERIES_COMPAT_linkedsemi-sdk-layer = "wrynose"
```

## meta-linkedsemi/conf/machine/include/linkedsemi-sdk.inc
```bitbake
# LinkedSemi SDK common settings
SDKIMAGE_FEATURES += "staticdev-pkgs"
LINKEDSEMI_GIT ?= "github.com/linkedsemi"
```

## meta-linkedsemi/conf/machine/include/ls2010-sdk.inc
```bitbake
require conf/machine/include/linkedsemi-sdk.inc
#@TYPE: Machine include
#@NAME: LinkedSemi LS2010 SoC level configuration (riscv64, C908)
DEFAULTTUNE = "riscv64"
require conf/machine/include/riscv/tune-riscv.inc

# OpenSBI (M-mode) settings
RISCV_SBI_PLAT = "generic"
RISCV_SBI_PAYLOAD = "u-boot.bin"
RISCV_SBI_FW_TEXT_START = "0xC0000000"

# U-Boot
UBOOT_ARCH = "riscv"
UBOOT_ENTRYPOINT = "0xC0400000"
UBOOT_LOADADDRESS = "0xC0400000"

# Console (uart12, 1152000 baud)
SERIAL_CONSOLES = "1152000;ttyS0"

# Provider selection
PREFERRED_PROVIDER_virtual/kernel = "linux-linkedsemi"
PREFERRED_PROVIDER_virtual/bootloader = "u-boot-linkedsemi"
PREFERRED_PROVIDER_opensbi = "opensbi-linkedsemi"
EXTRA_IMAGEDEPENDS += "opensbi-linkedsemi zero-stage-boot"
```
